## Embedded/main/Kconfig.projbuild
```kconfig
menu "EWF bring-up options"

config EWF_BENCH_SELFTEST_AUTORUN
    bool "启动后自动运行一次 BSP 自检"
    default n
    help
        仅供开发台架绕过人工触发、自动运行一次电源/绑带/复位/BSP 资源自检的构建使用。
        正式默认配置必须保持关闭，不得开机自动播放、振动或进入人工自检。

endmenu
```
